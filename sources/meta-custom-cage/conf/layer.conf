## sources/meta-custom-cage/conf/layer.conf
```bitbake
# meta-custom/conf/layer.conf

BBPATH .= ":${LAYERDIR}"
BBFILES += "${LAYERDIR}/recipes-*/*/*.bbappend"

LAYERVERSION_meta-custom = "1"
LAYERDEPENDS_meta-custom = "core"
```

## src/rsb-4411/sources/meta-yoctianos-advantech/conf/layer.conf
```bitbake
# Layer root
LAYERDIR := "${@os.path.normpath(os.path.dirname(d.getVar('FILE', True)) + '/..')}"

# Add the layer root to BBPATH
BBPATH .= ":${LAYERDIR}"

# Layer metadata
LAYERVERSION = "1"

# Collection and pattern (match the entire layer)
BBFILE_COLLECTIONS += "meta-yoctianos-advantech"
BBFILE_PATTERN_meta-yoctianos-advantech := "^${LAYERDIR}/"

# Dependencies and priority
LAYERDEPENDS_meta-yoctianos-advantech = "core"
BBFILE_PRIORITY_meta-yoctianos-advantech = "99"

# Yocto compatibility
LAYERSERIES_COMPAT_meta-yoctianos-advantech = "mickledore"

# Special Fixes for Meta Microcontroller
LAYERSERIES_COMPAT_meta-microcontroller += "mickledore "

PREMIRRORS:prepend = "\
    ftp://ftp.gnu.org/pub/gnu/ https://mirrors.ocf.berkeley.edu/gnu/ \n \
    http://ftp.gnu.org/pub/gnu/ https://mirrors.ocf.berkeley.edu/gnu/ \n \
    https://ftp.gnu.org/pub/gnu/ https://mirrors.ocf.berkeley.edu/gnu/ \n \
"
```

## src/rsb-4411/sources/meta-yoctianos-klipper/conf/layer.conf
```bitbake
# Layer root
LAYERDIR := "${@os.path.normpath(os.path.dirname(d.getVar('FILE', True)) + '/..')}"

# Add the layer root to BBPATH
BBPATH .= ":${LAYERDIR}"

# Layer metadata
LAYERVERSION = "1"

# Collection and pattern (match the entire layer)
BBFILE_COLLECTIONS += "meta-yoctianos-klipper"
BBFILE_PATTERN_meta-yoctianos-klipper := "^${LAYERDIR}/"

# Dependencies and priority
LAYERDEPENDS_meta-yoctianos-klipper = "core"
BBFILE_PRIORITY_meta-yoctianos-klipper = "6"

# Yocto compatibility
LAYERSERIES_COMPAT_meta-yoctianos-klipper = "mickledore"
```

## src/rsb-4411/sources/meta-yoctianos/conf/layer.conf
```bitbake
PREMIRRORS_prepend = "\
  http://.*/.* https://deb.debian.org/debian/ \n \
  http://.*/.* http://mirror.csclub.uwaterloo.ca/debian/ \n \
  http://.*/.* http://ftp.fr.debian.org/debian/ \n \
"

MIRRORS_prepend = "\
  http://.*/.* https://deb.debian.org/debian/ \n \
  http://.*/.* http://mirror.csclub.uwaterloo.ca/debian/ \n \
  http://.*/.* http://ftp.fr.debian.org/debian/ \n \
"

# Layer root
LAYERDIR := "${@os.path.normpath(os.path.dirname(d.getVar('FILE', True)) + '/..')}"

# Add the layer root to BBPATH
BBPATH .= ":${LAYERDIR}"

# Layer metadata
LAYERVERSION = "1"

# Collection and pattern (match the entire layer)
BBFILE_COLLECTIONS += "meta-yoctianos"
BBFILE_PATTERN_meta-yoctianos := "^${LAYERDIR}/"

# Dependencies and priority
LAYERDEPENDS_meta-yoctianos = "core"
BBFILE_PRIORITY_meta-yoctianos = "6"

# Yocto compatibility
LAYERSERIES_COMPAT_meta-yoctianos = "mickledore"
```
